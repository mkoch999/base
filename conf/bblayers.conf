## conf/bblayers.conf
```bitbake
LCONF_VERSION = "6"

BBPATH = "${TOPDIR}"
BSPDIR := "${@os.path.abspath(os.path.dirname(d.getVar('FILE', True)) + '/../..')}"

BBFILES ?= ""
BBLAYERS = " \
  ${BSPDIR}/openembedded-core/meta \
  ${BSPDIR}/meta-openembedded/meta-oe \
  ${BSPDIR}/meta-openembedded/meta-python \
  ${BSPDIR}/meta-openembedded/meta-networking \
  ${BSPDIR}/meta-openembedded/meta-webserver \
  ${BSPDIR}/meta-timesys \
  ${BSPDIR}/meta-qt5 \
  ${BSPDIR}/meta-st/meta-st-openstlinux \
  ${BSPDIR}/meta-st/meta-st-stm32mp \
  ${BSPDIR}/meta-st/meta-st-stm32mp-addons \
"
```
